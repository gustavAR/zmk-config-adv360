## config/west.yml
```yaml
manifest:
  remotes:
    - name: urob
      url-base: https://github.com/urob
  projects:
    - name: zmk
      remote: urob
      revision: main
      import: app/west.yml
  self:
    path: config
# manifest:
#   remotes:
#     - name: zmkfirmware
#       url-base: https://github.com/zmkfirmware
#     - name: refil
#       url-base: https://github.com/refil
#   projects:
#     - name: zmk
#       remote: refil
#       revision: adv360-z3
#       import: app/west.yml
#   self:
#     path: config
```
